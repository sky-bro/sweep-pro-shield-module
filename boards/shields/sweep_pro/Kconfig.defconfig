## boards/shields/sweep_pro/Kconfig.defconfig
```kconfig
# No whitespace after the comma or in your part name!
config SHIELD_SWEEP_PRO_LEFT
    def_bool $(shields_list_contains,sweep_pro_left)

# No whitespace after the comma or in your part name!
config SHIELD_SWEEP_PRO_RIGHT
    def_bool $(shields_list_contains,sweep_pro_right)
```
